## arch/arm/mach-rockchip/rk3066/Kconfig
```kconfig
if ROCKCHIP_RK3066

config TARGET_MK808
	select SPL_ROCKCHIP_NAND
	select SPL_ROCKUSB_NAND
	bool "MK808"
	help
	  MK808 is a RK3066-based board with 1 USB host and 1 USB OTG port,
	  HDMI and a micro-SD card slot. It also includes on-board NAND
	  and 1GB of SDRAM.

config ROCKCHIP_BOOT_MODE_REG
	default 0x20004040

config SYS_SOC
	default "rk3066"

config SYS_MALLOC_F_LEN
	default 0x20000

config SPL_LIBCOMMON_SUPPORT
	default y

config SPL_LIBGENERIC_SUPPORT
	default y

config SPL_SERIAL
	default y

config SPL_STACK
	default 0x66000000

config SPL_SYS_MALLOC_F_LEN
	default 0x20000

config SYS_NAND_BLOCK_SIZE
	default 0x0

config TPL_LDSCRIPT
	default "arch/arm/mach-rockchip/u-boot-tpl.lds"

config TPL_LIBCOMMON_SUPPORT
	default y

config TPL_LIBGENERIC_SUPPORT
	default y

config TPL_NEEDS_SEPARATE_STACK
	default y

config TPL_SYS_MALLOC_F_LEN
	default 0x2000

config TPL_SERIAL
	default y

config TPL_STACK
	default 0x1008FFFF

source "board/rikomagic/mk808/Kconfig"

endif
```

## configs/mk808-rk3066_defconfig
```kconfig
CONFIG_ARM=y
CONFIG_ARCH_ROCKCHIP=y
CONFIG_ROCKCHIP_RK3066=y
CONFIG_TARGET_MK808_RK3066=y
CONFIG_DEFAULT_DEVICE_TREE="rk3066a-mk808"
CONFIG_CMD_REGULATOR=y
CONFIG_CLK=y
CONFIG_REGMAP=y
CONFIG_SYSCON=y
CONFIG_RAM=y
CONFIG_SYS_MALLOC_F_LEN=0x2000
CONFIG_USE_PRIVATE_LIBGCC=y
CONFIG_CMD_DHRYSTONE=y
CONFIG_ERRNO_STR=y
CONFIG_SYS_NS16550=y
CONFIG_BOOTDELAY=1
CONFIG_CONSOLE_MUX=y
CONFIG_DISPLAY_BOARDINFO=y
CONFIG_CMD_BOOTZ=y
CONFIG_DM_REGULATOR_FIXED=y
CONFIG_CMD_EXT4=y
CONFIG_CMD_FS_GENERIC=y
CONFIG_DM_REGULATOR_GPIO=y
CONFIG_SYSRESET=y
CONFIG_CMD_MMC=y
CONFIG_MMC_DW=y
CONFIG_MMC_DW_ROCKCHIP=y
CONFIG_DM_MMC=y
# CONFIG_CMD_IMLS is not set
# CONFIG_CMD_SETEXPR is not set
# CONFIG_EFI_PARTITION is not set
# CONFIG_CMD_BOOTEFI is not set
# CONFIG_CMD_BOOTEFI_HELLO_COMPILE is not set
# CONFIG_EFI_LOADER is not set
#CONFIG_CMD_GPIO=y
#CONFIG_ROCKCHIP_GPIO=y
CONFIG_PINCTRL=y
CONFIG_PINCTRL_GENERIC=y
CONFIG_PINCTRL_ROCKCHIP_RK3066=y
CONFIG_DEBUG_UART=y
CONFIG_DEBUG_UART_BASE=0x20064000
CONFIG_DEBUG_UART_CLOCK=24000000
CONFIG_DEBUG_UART_SHIFT=2
# CONFIG_TPL_DM_SERIAL is not set
CONFIG_SPL_TINY_MEMSET=y
# CONFIG_SPL_USE_ARCH_MEMCPY is not set
# CONFIG_SPL_USE_ARCH_MEMSET is not set
# CONFIG_SPL_SIMPLE_BUS is not set
CONFIG_OF_SPL_REMOVE_PROPS="pinctrl-0 pinctrl-names clock-names interrupt-parent assigned-clocks assigned-clock-rates assigned-clock-parents"
# CONFIG_SPL_PINCTRL_FULL is not set
# CONFIG_SPL_MMC_SUPPORT is not set
CONFIG_BOARD_LATE_INIT=y
CONFIG_OF_PLATDATA=y
CONFIG_ROCKCHIP_SPL_BACK_TO_BROM=y

# CONFIG_CMD_FAT is not set
# CONFIG_FS_FAT is not set
# CONFIG_CMD_CONSOLE is not set
# CONFIG_DM_PWM is not set
# CONFIG_CMD_NET is not set
# CONFIG_CMD_NET is not set
# CONFIG_SUPPORT_RAW_INITRD is not set
# CONFIG_CMD_FS_GENERIC is not set
# CONFIG_REGEX is not set
# CONFIG_CMD_FLASH is not set
# CONFIG_CMD_SAVEENV is not set
# CONFIG_BOOTM_PLAN9 is not set
# CONFIG_BOOTP_DNS is not set
# CONFIG_CMD_MEMORY is not set
# CONFIG_DM_SPI_FLASH is not set
# CONFIG_BOOTP_HOSTNAME is not set
# CONFIG_NET is not set
# CONFIG_ISO_PARTITION is not set
# CONFIG_CMD_DM is not set
# CONFIG_CMD_BOOTD is not set

# CONFIG_CMD_BOOTZ is not set
# CONFIG_AUTO_COMPLETE is not set
# CONFIG_DM_REGULATOR is not set
CONFIG_DOS_PARTITION=y
# CONFIG_CMD_FPGA is not set
# CONFIG_IMAGE_FORMAT_LEGACY is not set
# CONFIG_NET_TFTP_VARS is not set
# CONFIG_CMD_DHCP is not set
# CONFIG_CMD_ECHO is not set
# CONFIG_BOOTP_GATEWAY is not set
# CONFIG_SPL_ISO_PARTITION is not set
# CONFIG_BOOTP_PXE is not set
# CONFIG_PARTITION_UUIDS is not set
# CONFIG_CMD_IMPORTENV is not set
# CONFIG_CMD_EXPORTENV is not set
# CONFIG_CMD_ELF is not set
# CONFIG_CMD_LOADB is not set
# CONFIG_CMD_LOADS is not set
# CONFIG_CMD_IMI is not set
# CONFIG_LMB is not set
# CONFIG_CMD_BDI is not set
# CONFIG_DM_SPI is not set
# CONFIG_BOOTM_NETBSD is not set
# CONFIG_BOOTM_NETBSD is not set
# CONFIG_BOOTM_VXWORKS is not set
# CONFIG_CMD_EDITENV is not set
# CONFIG_CMD_PART is not set
# CONFIG_SYS_LONGHELP is not set
# CONFIG_CMD_XIMG is not set
# CONFIG_CMD_CACHE is not set
```

## configs/mk808_defconfig
```kconfig
CONFIG_ARM=y
CONFIG_SPL_SYS_THUMB_BUILD=y
CONFIG_TPL_SYS_THUMB_BUILD=y
# CONFIG_SPL_USE_ARCH_MEMCPY is not set
# CONFIG_TPL_USE_ARCH_MEMSET is not set
CONFIG_ARCH_ROCKCHIP=y
CONFIG_SYS_TEXT_BASE=0x60000000
CONFIG_NR_DRAM_BANKS=1
CONFIG_ENV_SIZE=0x8000
CONFIG_DEFAULT_DEVICE_TREE="rk3066a-mk808"
CONFIG_SPL_TEXT_BASE=0x60000000
CONFIG_ROCKCHIP_RK3066=y
CONFIG_TPL_TEXT_BASE=0x10080C04
CONFIG_TPL_MAX_SIZE=32764
CONFIG_TARGET_MK808=y
CONFIG_SPL_STACK_R_ADDR=0x78000000
CONFIG_DEBUG_UART_BASE=0x20064000
CONFIG_DEBUG_UART_CLOCK=24000000
# CONFIG_SPL_FS_FAT is not set
CONFIG_SPL_SYS_MALLOC_SIMPLE=y
CONFIG_SPL_PAYLOAD="u-boot.bin"
CONFIG_DEBUG_UART=y
CONFIG_SYS_LOAD_ADDR=0x70A00800
CONFIG_SD_BOOT=y
CONFIG_USE_PREBOOT=y
CONFIG_DEFAULT_FDT_FILE="rk3066a-mk808.dtb"
# CONFIG_DISPLAY_CPUINFO is not set
CONFIG_DISPLAY_BOARDINFO_LATE=y
CONFIG_BOARD_LATE_INIT=y
CONFIG_SPL_USBPLUG=y
CONFIG_SPL_USB_FUNCTION_ROCKUSB=y
CONFIG_SPL_ROCKUSB=y
CONFIG_SPL_ROCKUSB_SUPPORT=y
CONFIG_USB_GADGET=y
CONFIG_SPL_USB_GADGET=y
CONFIG_SPL_ENV_SUPPORT=y
CONFIG_DM=y
CONFIG_USB=y
CONFIG_DM_USB=y
CONFIG_SPL_DM=y
CONFIG_DM_DEV_READ_INLINE=y
CONFIG_SPL_DM_USB=y
CONFIG_SPL_DM_USB_GADGET=y
CONFIG_USB_GADGET_DWC2_OTG=y
# CONFIG_LTO is not set
# CONFIG_SPL_DM_SPI is not set
# CONFIG_SPL_RAW_IMAGE_SUPPORT is not set
CONFIG_SPL_FRAMEWORK=y
# CONFIG_SPL_DOS_PARTITION is not set
# CONFIG_SPL_PARTITION_UUIDS is not set
# CONFIG_USB_FUNCTION_FASTBOOT is not set
# CONFIG_SPL_LEGACY_IMAGE_SUPPORT is not set
CONFIG_SPL_STACK_R=y
CONFIG_SPL_STACK_R_MALLOC_SIMPLE_LEN=0x200000
# CONFIG_SPL_FS_EXT4 is not set
CONFIG_TPL_NEEDS_SEPARATE_TEXT_BASE=y
CONFIG_TPL_NEEDS_SEPARATE_STACK=y
# CONFIG_BOOTM_PLAN9 is not set
# CONFIG_BOOTM_RTEMS is not set
# CONFIG_BOOTM_VXWORKS is not set
CONFIG_CMD_GPT=y
CONFIG_CMD_MMC=y
# CONFIG_CMD_SETEXPR is not set
CONFIG_CMD_CACHE=y
CONFIG_CMD_TIME=y
CONFIG_CMD_REGULATOR=y
CONFIG_SPL_OF_CONTROL=y
CONFIG_TPL_OF_CONTROL=y
CONFIG_OF_SPL_REMOVE_PROPS="interrupt-parent assigned-clocks assigned-clock-rates assigned-clock-parents"
CONFIG_OF_DTB_PROPS_REMOVE=y
# CONFIG_SPL_OF_PLATDATA is not set
CONFIG_TPL_OF_PLATDATA=y
CONFIG_SYS_RELOC_GD_ENV_ADDR=y
# CONFIG_NET is not set
CONFIG_TPL_DM=y
# CONFIG_DM_WARN is not set
CONFIG_REGMAP=y
CONFIG_SPL_REGMAP=y
CONFIG_TPL_REGMAP=y
CONFIG_SYSCON=y
CONFIG_SPL_SYSCON=y
CONFIG_TPL_SYSCON=y
# CONFIG_SIMPLE_BUS is not set
# CONFIG_SPL_SIMPLE_BUS is not set
# CONFIG_TPL_BLK is not set
CONFIG_CLK=y
CONFIG_SPL_CLK=y
CONFIG_TPL_CLK=y
# CONFIG_SPL_DM_I2C is not set
CONFIG_LED=y
CONFIG_SF_DEFAULT_SPEED=20000000
CONFIG_PINCTRL=y
# CONFIG_DM_PMIC is not set
# CONFIG_SPL_PMIC_CHILDREN is not set
CONFIG_DM_REGULATOR_GPIO=y
CONFIG_RAM=y
# CONFIG_SPL_RAM is not set
CONFIG_TPL_RAM=y
CONFIG_DM_RESET=y
# CONFIG_REQUIRE_SERIAL_CONSOLE is not set
CONFIG_DEBUG_UART_SHIFT=2
CONFIG_ROCKCHIP_SERIAL=y
CONFIG_SYSRESET=y
CONFIG_TIMER=y
CONFIG_SPL_TIMER=y
CONFIG_TPL_TIMER=y
CONFIG_DESIGNWARE_APB_TIMER=y
CONFIG_SPL_TINY_MEMSET=y
# CONFIG_ERRNO_STR is not set
# CONFIG_TPL_OF_LIBFDT is not set
# CONFIG_SPL_GPIO is not set
# CONFIG_SPL_DM_REGULATOR_GPIO is not set
# CONFIG_OF_LIVE is not set
# CONFIG_SPL_PINCTRL_FULL is not set
# CONFIG_SPL_PINCTRL is not set
CONFIG_MTD=y
CONFIG_MTD_RAW_NAND=y
CONFIG_SPL_MTD_SUPPORT=y
CONFIG_SPL_NAND_IDENT=y
CONFIG_SPL_ROCKCHIP_NAND=y
CONFIG_SPL_ROCKUSB_NAND=y
CONFIG_SPL_NAND_SUPPORT=y
CONFIG_SYS_NAND_BLOCK_SIZE=0x0
```

## drivers/rockusb/Kconfig
```kconfig
menu "ROCKUSB support"

config ROCKUSB
        bool "ROCKUSB gadget"
        depends on USB_GADGET && USB_FUNCTION_ROCKUSB
        help
          Enable ROCKUSB gadget support.
          Rockusb protocol is widely used by Rockchip SoC based devices. It can
          read/write info, image to/from devices. This enables the USB part of
          the rockusb gadget. For more detail about Rockusb protocol, please see
          doc/README.rockusb


if ROCKUSB

config ROCKUSB_MMC
        bool "MMC backend for ROCKUSB"
        depends on DM_MMC
        help
          This option enables using ROCKUSB to read and write to MMC based storage.
          Rockusb protocol is widely used by Rockchip SoC based devices. It can
          read/write info, image to/from devices. This enables the USB part of
          the rockusb gadget. For more detail about Rockusb protocol, please see
          doc/README.rockusb

endif

config SPL_ROCKUSB
        bool "SPL ROCKUSB gadget"
        depends on USB_GADGET && SPL_USB_FUNCTION_ROCKUSB
        help
          Enable SPL ROCKUSB gadget support.
          Rockusb protocol is widely used by Rockchip SoC based devices. It can
          read/write info, image to/from devices. This enables the USB part of
          the rockusb gadget. For more detail about Rockusb protocol, please see
          doc/README.rockusb

if SPL_ROCKUSB

config SPL_ROCKUSB_MMC
        bool "SPL MMC backend for ROCKUSB"
        depends on SPL_DM_MMC
        help
          This option enables using ROCKUSB to read and write to MMC based
          storage in SPL.
          Rockusb protocol is widely used by Rockchip SoC based devices. It can
          read/write info, image to/from devices. This enables the USB part of
          the rockusb gadget. For more detail about Rockusb protocol, please see
          doc/README.rockusb

endif

endmenu
```
